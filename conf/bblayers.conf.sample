## conf/bblayers.conf.sample
```bitbake
# LAYER_CONF_VERSION is increased each time build/conf/bblayers.conf
# changes incompatibly
LCONF_VERSION = "5"

BBPATH = "${TOPDIR}"
BBFILES ?= ""

BBLAYERS ?= " \
  ##COREBASE##/meta \
  ##COREBASE##/../meta-ettus \
  ##COREBASE##/../meta-xilinx \
  ##COREBASE##/../meta-oe/meta-oe \
  ##COREBASE##/../meta-oe/meta-networking \
  ##COREBASE##/../meta-oe/meta-filesystems \
  ##COREBASE##/../meta-oe/meta-python \
  ##COREBASE##/../meta-qt4 \
  ##COREBASE##/../meta-sdr \
  ##COREBASE##/../meta-fsl-arm \
  ##COREBASE##/../meta-fsl-arm-extra \
  ##COREBASE##/../meta-ti \
  "
```

## wic/gnuradio-dev-image.wks
```
# short-description: Create SD card image with a boot partition
# long-description: Creates a partitioned SD card image. Boot files
# are located in the first vfat partition.

part /boot --source bootimg-partition --ondisk mmcblk0 --fstype=vfat --label boot --active --align 4 --size 128
part / --source rootfs --ondisk mmcblk0 --fstype=ext4 --label root --align 4 --size 5500
```

## wic/sdimage-16G-2.wks
```
# short-description: Create SD card image with a boot partition
# long-description: Creates a partitioned SD card image. Boot files
# are located in the first vfat partition.

part /boot --source bootimg-partition --ondisk mmcblk0 --fstype=vfat --label boot --active --align 4 --size 16
part / --source rootfs --ondisk mmcblk0 --fstype=ext4 --label rootfs1 --align 4 --size 5500
part "" --ondisk mmcblk0 --fstype=ext4 --label rootfs2 --align 4 --size 5500
```
